## u-boot-2017.05/board/amcc/flyer3d/Kconfig
```kconfig
if TARGET_FLYER3D

config SYS_BOARD
	default "flyer3d"

config SYS_VENDOR
	default "amcc"

config SYS_CONFIG_NAME
	default "flyer3d"

config BOOT_SWITCH
	int 
	default 1
config FLASH_BIT
	int 
	default 9
config FLASH_BIT1
	int 
	default 10
config SWITCH_BIT
	int 
	default 3
config SWITCH_BIT1
	int
	default 4
config SWITCH_BIT2
	int 
	default 38
config SWITCH_BIT3
	int 
	default 37
config SYS_FLASH2
	hex 
	default 0xfc000000
config SYS_I2C_MULTI_EEPROMS
	bool 
	default y
config SYS_RTC
	hex 
	default 0xfb100000
config PHY_MII
	bool
	default y

endif
```

## u-boot-2017.05/configs/flyer3d_defconfig
```kconfig
CONFIG_PPC=y
CONFIG_4xx=y
CONFIG_TARGET_FLYER3D=y
CONFIG_OF_BOARD_SETUP=y
CONFIG_SYS_EXTRA_OPTIONS="YOSEMITE"
CONFIG_BOOTDELAY=3
CONFIG_SYS_CONSOLE_INFO_QUIET=y
CONFIG_VERSION_VARIABLE=y
CONFIG_BOARD_EARLY_INIT_F=y
CONFIG_HUSH_PARSER=y
CONFIG_CMD_ASKENV=y
CONFIG_CMD_GREPENV=y
CONFIG_LOOPW=y
CONFIG_CMD_I2C=y
CONFIG_CMD_USB=y
CONFIG_CMD_DHCP=y
CONFIG_CMD_MII=y
CONFIG_CMD_PING=y
CONFIG_CMD_CACHE=y
CONFIG_CMD_EXT2=y
CONFIG_CMD_FAT=y
CONFIG_CMD_DIAG=y
CONFIG_MAC_PARTITION=y
CONFIG_ISO_PARTITION=y
# CONFIG_MMC is not set
CONFIG_MTD_NOR_FLASH=y
# CONFIG_PCI_PNP is not set
CONFIG_SYS_NS16550=y
CONFIG_USB=y
CONFIG_USB_STORAGE=y
CONFIG_OF_LIBFDT=y
CONFIG_LED_STATUS=y
CONFIG_LED_STATUS0=y
CONFIG_LED_BLINK_FREQ=2
CONFIG_LED_STATUS_BIT=1
CONFIG_LED_STATUS_STATE=1
CONFIG_LED_STATUS_BOARD_SPECIFIC=y
```
